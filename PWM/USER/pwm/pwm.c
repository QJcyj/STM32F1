#include "pwm.h"


void TIM2PWMInit(u32 arr,u32 psc)
{

	RCC->APB1ENR |=1; 	//TIM2时钟使能   
	RCC->APB2ENR |=1<<2;    	//使能PORTA时钟
	RCC->APB2ENR |=1<<3;    	//使能PORTB时钟	
	GPIOA->CRL   &=0XFFFF0000;	//PA输出
	GPIOA->CRL   |=0X0000BBBB;	//复用功能输出 
	TIM2->ARR=arr;			//设定计数器自动重装值 
	TIM2->PSC=psc;			//预分频器不分频
	TIM2->CCMR1|=7<<4;  	//CH1 PWM2模式		 
	TIM2->CCMR1|=1<<3; 	  //CH1预装载使能	 
	TIM2->CCMR1|=7<<12;  	//CH2 PWM2模式		 
	TIM2->CCMR1|=1<<11; 	//CH2预装载使能	
	TIM2->CCMR2|=7<<4;  	//CH3 PWM2模式		 
	TIM2->CCMR2|=1<<3; 	  //CH3预装载使能	 
	TIM2->CCMR2|=7<<12;  	//CH4 PWM2模式		 
	TIM2->CCMR2|=1<<11; 	//CH4预装载使能	
	TIM2->CCER|=0x1111;   	//OC1-4 输出使能	 
	TIM2->CR1=0x0080;   	//ARPE使能 
	TIM2->CR1|=0x01;    	//使能定时器2计数
}

/******************************
*	ch1-ch4对应PA0-PA4,取值：0-1000
*	999对应1ms
*
*
*******************************/
/************************************************************************************************
*PWM原理如下:我们假定定时器工作在向上计数 PWM模式，且当CNT<CCRx时，输出0当CNT>=CCRx时输出1。
那么就可以得到如下的 PWM示意图：当CNT值小于CCRx的时候，IO输出低电平(0)，当CNT值大于等于CCRx的时候，
IO输出高电平(1)，当CNT达到ARR值的时候，重新归零，然后重新向上计数，依次循环。改变 CCRx 的值，就可以
改变 PWM 输出的占空比，改变 ARR 的值，就可以改变 PWM 输出的频率

        ^ CNT
        |___________________________________________ARR
        |	  /|	 /|	    /|	   /|	  /|
        |____/_|____/_|____/_|____/_|____/_|________CCRx
        |	/  |   /  |	  /	 |	 /	|	/  |
        |  /   |  /	  |	 /	 |	/   |  /   |
        | /	   | /	  |	/	 | /    | /	   |
        |/_____|/_____|/_____|/_____|/_____|_______> t
    1	|	 __	    __	   __	  __	 __
        |	|  |   |  |	  |  |	 | 	|	|  |
    0   |___|  |___|  |___|__|___|__|___|__|_________
*****************************************************************************************************/
void PWMOut(u16 ch1,u16 ch2,u16 ch3,u16 ch4)
{
    if(ch2>1000)	ch1=1000;
    if(ch2>1000)	ch2=1000;
    if(ch3>1000)	ch3=1000;
    if(ch4>1000)	ch4=1000;
    TIM2->CCR1 = 19999-(ch1+999);
    TIM2->CCR2 = 19999-(ch2+999);
    TIM2->CCR3 = 19999-(ch3+999);
    TIM2->CCR4 = 19999-(ch4+999);
}








